## base/installer/Kconfig
```kconfig
# Copyright 2026 dywoq - Apache License 2.0
# https://github.com/dywoq/vacui

menu "Vacui VQ installer"

source "val/Kconfig"

endmenu
```

## boot/load/Kconfig
```kconfig
# Copyright 2026 dywoq - Apache License 2.0
# A part of https://github.com/dywoq/vacui

menu "Vacui boot load config"

source "hub/Kconfig"

endmenu
```

## boot/primary/debug/Kconfig
```kconfig
# Copyright 2026 dywoq - Apache License 2.0
# A part of https://github.com/dywoq/vacui

menu "Debugging"

config DEBUG_ON
    bool "Debugging status (on/off)"
    help
        Manages debugging mode in the boot primary stage.

        If it's enabled:
        - the debug messages are enabled and go into
        final build leading to the larger binary size;
        - base_debug_* macros are expanded

        It's recommended to use it only in non-production builds.

endmenu
```

## kernel/Kconfig
```kconfig
# Copyright 2026 dywoq - Apache License 2.0
# A part of https://github.com/dywoq/vacui

source "hub/Kconfig"
source "utility/Kconfig"
source "base/Kconfig"
source "devices/Kconfig"
source "task/Kconfig"
```

## kernel/hub/Kconfig
```kconfig
# Copyright 2026 dywoq - Apache License 2.0
# A part of https://github.com/dywoq/vacui

menu "Hub"

config HUB_DEBUG
        bool "Hub debugging"
        default y
        depends on UTILITY_DEBUG 
        help
                Enables debug features for hub module.
                Depends on CONFIG_UTILITY_DEBUG option.

endmenu
```

## kernel/task/Kconfig
```kconfig
# Copyright 2026 dywoq - Apache License 2.0
# A part of https://github.com/dywoq/vacui

menu "Task manager"

endmenu
```

## kernel/utility/Kconfig
```kconfig
# Copyright 2026 dywoq - Apache License 2.0
# A part of https://github.com/dywoq/vacui

menu "Utility"

config UTILITY_DEBUG
        bool "Debug mode (ON/OFF)"
        default y
        help
                If it's on, the debug features (such as logging) are enabled.

endmenu
```
